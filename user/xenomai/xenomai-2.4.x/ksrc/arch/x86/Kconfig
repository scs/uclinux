## user/xenomai/xenomai-2.4.x/ksrc/arch/x86/Kconfig
```kconfig
config XENO_GENERIC_STACKPOOL
	bool
	default y

source "kernel/xenomai/nucleus/Kconfig"

menu "Machine"

depends on XENO_OPT_NUCLEUS

config XENO_HW_FPU
	bool "Enable FPU support"
	default y
	help
	The FPU executes instructions from the processor's normal
	instruction stream. It can handle the types of high-precision
	floating-point processing operations commonly found in
	scientific, engineering, and business applications.
	If your target system has no FPU, say NO here; otherwise,
	enabling FPU support when available may greatly improve
	performance. You can obtain more information about the
	Float-Point Unit on the x86 platform at the following URL:
	http://www.intel.com/design/intarch/techinfo/Pentium/fpu.htm

if !X86_64

menu "NMI watchdog"

config XENO_HW_NMI_DEBUG_LATENCY
        depends on X86_LOCAL_APIC
        bool "Enable NMI watchdog"
        default n
        help
        Enabling this option allows the NMI watchdog to be used in order
        to debug abnormal (timer) interrupt latencies.

        The NMI watchog is programmed in order to expire a certain time 
        after the currently awaited timer shot, and triggers if the shot 
        did not happen as expected. This allowed amount of jitter is 
        configurable. When triggered, the NMI watchdog prints the call
        stack and causes a kernel panic, which should hopefully allow to
        find out why the timer got delayed.

        This option is mainly useful for debugging Xenomai internals, and 
        not meant for debugging applications.

config XENO_HW_NMI_DEBUG_LATENCY_MAX
        depends on XENO_HW_NMI_DEBUG_LATENCY
        int "NMI watchdog latency threshold (us)"
        default 100
        help
        When the timer interrupt latency goes above this threshold, the
        NMI watchdog pulls the handbrake.

endmenu

endif

menu "SMI workaround"

config XENO_HW_SMI_DETECT_DISABLE
        bool "Disable SMI detection"
        default n
        help
        SMI are System Management Interrupts, generated by Intel ICH
        (I/O connector hubs) to allow handling of some specific events;
        on systems where they exist, they are the highest priority
        interrupts (even higher priority than NMIs). Common SMI sources
        are power management, legacy devices emulation by BIOS, SMBus
        and TCO watchdog. 

        SMI are problematic for Xenomai, because their handling may span
        accross hundreds of microseconds, causing unacceptable interrupt 
        latency. Furthermore, their vectors are stored in some ROM, 
        and hence may not be altered.

        For this reason, Xenomai contains code to detect chipsets using
        SMIs and optionally activate some workarounds to stop SMIs.
        
        Enabling this option prevents Xenomai from detecting whether 
        your hardware use SMIs. This option is mostly useful if you know
        that your system does not use SMIs and really want to size Xenomai 
        modules down. The detection code has no run-time space overhead,
        and a tiny memory footprint (<200 bytes on x86)

config XENO_HW_SMI_DETECT
        bool
        depends on !XENO_HW_SMI_DETECT_DISABLE
        default y

config XENO_HW_SMI_WORKAROUND
        depends on XENO_HW_SMI_DETECT
        bool "Enable SMI workaround"
        default n
        help
        SMI are System Management Interrupts, generated by Intel ICH
        (I/O connector hubs) to allow handling of some specific events;
        on systems where they exist, they are the highest priority
        interrupts (even higher priority than NMIs). Common SMI sources
        are power management, legacy devices emulation by BIOS, SMBus
        and TCO watchdog. 

        SMI are problematic for Xenomai, because their handling may span
        accross hundreds of microseconds, causing unacceptable interrupt 
        latency. Furthermore, their vectors are stored in some ROM, 
        and hence may not be altered.

        For this reason, Xenomai contains code to detect chipsets using
        SMIs and optionally activate some workarounds to stop SMIs.
        Enabling this option cause those workarounds to be activated.

if XENO_HW_SMI_WORKAROUND

config XENO_HW_SMI_ALL
        bool "Globally disable SMI"
        default y
        help
        This option causes the SMIs to be globally disabled, which avoid
        any jitter they could cause with a big drawback: any peripheral or
        feature relying on them will stop working when Xenomai is running.

        The alternative is to selectively enable the SMIs sources needed 
        by your peripherals. The main drawback is that the peripheral 
        which you need may be the one causing jitter, so that extensive
        testing is needed when choosing to not disable SMI globally. 
        Another drawback is that other unknown SMI sources may exist which
        Xenomai can not disable.

        This option causes the SMIs to be globally disabled.

config XENO_HW_SMI_INTEL_USB2
        bool "Enable Intel-Specific USB2 SMI"
        depends on !XENO_HW_SMI_ALL
        default n
        help
        This options enables Intel-specific USB2 SMI logic to cause SMIs.

config XENO_HW_SMI_LEGACY_USB2
        bool "Enable legacy USB2 SMI"
        depends on !XENO_HW_SMI_ALL
        default n
        help
        This options enables legacy USB2 logic to cause SMIs.

config XENO_HW_SMI_PERIODIC
        bool "Enable periodic SMI"
        depends on !XENO_HW_SMI_ALL
        default n
        help
        This options enables the ICH to generate a periodic SMI.

config XENO_HW_SMI_TCO
        bool "Enable TCO SMI"
        depends on !XENO_HW_SMI_ALL
        default n
        help
        This options enables the TCO logic to generate SMIs.

config XENO_HW_SMI_MC
        bool "Enable microcontroller SMI"
        depends on !XENO_HW_SMI_ALL
        default n
        help
        This options enables the ICH to trap access to the 
        microcontroller range.

config XENO_HW_SMI_APMC
        bool "Enable APM SMI"
        depends on !XENO_HW_SMI_ALL
        default n
        help
        This options enables writes to the APM control register to 
        cause SMIs.

config XENO_HW_SMI_LEGACY_USB
        bool "Enable legacy USB SMI"
        depends on !XENO_HW_SMI_ALL
        default n
        help
        This options enables legacy USB circuit to cause SMIs.

config XENO_HW_SMI_BIOS
        bool "Enable ACPI BIOS SMI"
        depends on !XENO_HW_SMI_ALL
        default n
        help
        This options enables SMI to be used for communication
        between ACPI software and BIOS software.

endif

endmenu

endmenu

source "kernel/xenomai/skins/Kconfig"
source "drivers/xenomai/Kconfig"
```

## user/xenomai/xenomai-2.4.x/ksrc/drivers/can/Kconfig
```kconfig
menu "CAN drivers"

config XENO_DRIVERS_CAN
	depends on XENO_SKIN_RTDM
	tristate "RT-Socket-CAN, CAN raw socket interface"
	help
	RT-Socket-CAN is a real-time socket interface for CAN controllers.

config XENO_DRIVERS_CAN_DEBUG
	depends on XENO_DRIVERS_CAN
	bool "Enable debug output"
	default y
	help

	This option activates debugging checks and enhanced output for the
	RT-Socket-CAN driver. It also allows to list the hardware registers
	of the registered CAN controllers. It is a recommended option for
	getting started and analysing potential problems. For production
	purposes, it should be switched off (for the sake of latency).

config XENO_DRIVERS_CAN_LOOPBACK
	depends on XENO_DRIVERS_CAN
	bool "Enable TX loopback to local sockets"
	default n
	help

	This options adds support for TX loopback to local sockets. Normally,
	messages sent to the CAN bus are not visible to sockets listening to
	the same local device. When this option is enabled, TX messages are
	looped back locally when the transmit has been done by default. This
	behaviour can be deactivated or reactivated with "setsockopt". Enable
	this option, if you want to have a "net-alike" behaviour.

config XENO_DRIVERS_CAN_RXBUF_SIZE
	depends on XENO_DRIVERS_CAN
	int "Size of receive ring buffers (must be 2^N)"
	default 1024

config XENO_DRIVERS_CAN_MAX_DEVICES
	depends on XENO_DRIVERS_CAN
	int "Maximum number of devices"
	default 4

config XENO_DRIVERS_CAN_MAX_RECEIVERS
	depends on XENO_DRIVERS_CAN
	int "Maximum number of receive filters per device"
	default 16
	help

	The driver maintains a receive filter list per device for fast access.

config XENO_DRIVERS_CAN_BUS_ERR
	depends on XENO_DRIVERS_CAN
	bool
	default n
	help

	To avoid unnecessary bus error interrupt flooding, this option enables
	bus error interrupts when an application is calling a receive function
	on a socket listening on bus errors. After one bus error has occured,
	the interrupt will be disabled to allow the application time for error
	processing. This option is automatically selected for CAN controllers
	supporting bus error interrupts like the SJA1000.

config XENO_DRIVERS_CAN_VIRT
	depends on XENO_DRIVERS_CAN
	tristate "Virtual CAN bus driver"
	help

	This driver provides two CAN ports that are virtually interconnected.
	More ports can be enabled with the module parameter "devices".

source drivers/xenomai/can/mscan/Kconfig
source drivers/xenomai/can/sja1000/Kconfig

endmenu
```

## user/xenomai/xenomai-2.4.x/ksrc/drivers/can/mscan/Kconfig
```kconfig
config XENO_DRIVERS_CAN_MSCAN
	depends on XENO_DRIVERS_CAN && PPC_MPC52xx
	tristate "MSCAN driver for MPC52xx"
	default n

config XENO_DRIVERS_CAN_MSCAN_1
	depends on XENO_DRIVERS_CAN_MSCAN
	bool "Enable CAN 1"
	default y

config XENO_DRIVERS_CAN_MSCAN_2
	depends on XENO_DRIVERS_CAN_MSCAN
	bool "Enable CAN 2"
	default y

config XENO_DRIVERS_CAN_MSCAN_CLOCK
	depends on XENO_DRIVERS_CAN_MSCAN
	int "Clock Frequency in Hz"
	default 66000000
	help

	The MSCAN driver selects the oscillator clock (SYS_XTAL_IN) as clock
	source for MSCAN, which is typically 33 MHz. Due to a hardware bug on
	the MPC5200 Rev. A chips, the IP bus clock (IP_CLK) is used instead,
	which is typically 66 or 132 MHz.

choice
	depends on XENO_DRIVERS_CAN_MSCAN
	prompt "Pin Configuration"
	default I2C1/TMR01
	help

config XENO_DRIVERS_CAN_MSCAN_ALT
	bool "CAN 1 on I2C1 pins, CAN 2 on TMR01 pins"

config XENO_DRIVERS_CAN_MSCAN_PSC2
	bool "CAN 1 and 2 on PSC2 pins"

endchoice
```

## user/xenomai/xenomai-2.4.x/ksrc/drivers/can/sja1000/Kconfig
```kconfig
config XENO_DRIVERS_CAN_SJA1000
	depends on XENO_DRIVERS_CAN
	tristate "Philips SJA1000 CAN controller"
	select XENO_DRIVERS_CAN_BUS_ERR

config XENO_DRIVERS_CAN_SJA1000_ISA
	depends on XENO_DRIVERS_CAN_SJA1000
	tristate "Standard ISA controllers"
	help

	This driver is for CAN devices connected to the ISA bus of a PC
	or a PC/104 system. The I/O port, interrupt number and a few other
	hardware specific parameters can be defined via module parameters.

config XENO_DRIVERS_CAN_SJA1000_MEM
	depends on XENO_DRIVERS_CAN_SJA1000
	tristate "Memory mapped controllers"
	help

	This driver is for memory mapped CAN devices. The memory address,
	interrupt number and a few other hardware specific parameters can
	be defined via module parameters.

config XENO_DRIVERS_CAN_SJA1000_PEAK_PCI
	depends on XENO_DRIVERS_CAN_SJA1000
	tristate "PEAK PCI Card"
	help

	This driver is for the PCAN PCI, the PC-PCI CAN plug-in card (1 or
	2 channel) from PEAK Systems (http://www.peak-system.com). To get
	the second channel working, Xenomai's shared interrupt support
	must be enabled.

config XENO_DRIVERS_CAN_SJA1000_IXXAT_PCI
	depends on XENO_DRIVERS_CAN_SJA1000
	tristate "IXXAT PCI Card"
	help

	This driver is for the IXXAT PC-I 04/PCI card (1 or 2 channel)
	from the IXXAT Automation GmbH (http://www.ixxat.de). To get
	the second channel working, Xenomai's shared interrupt support
	must be enabled.


config XENO_DRIVERS_CAN_SJA1000_EMS_PCI
	depends on XENO_DRIVERS_CAN_SJA1000
	tristate "EMS CPC PCI Card"
	help

	This driver is for the 2 channel CPC PCI card from EMS Dr. Thomas
	Wünsche (http://www.ems-wuensche.de). To get the second channel
	working, Xenomai's shared interrupt support must be enabled.


config XENO_DRIVERS_CAN_SJA1000_PEAK_DNG
	depends on XENO_DRIVERS_CAN_SJA1000
	tristate "PEAK Parallel Port Dongle"
	help

	This driver is for the PCAN Dongle, the PC parallel port to CAN
	converter from PEAK Systems (http://www.peak-system.com). You need
	to disable parallel port support in the kernel (CONFIG_PARPORT) for
	proper operation. The interface type (sp or epp), I/O port and
	interrupt number should be defined via module parameters.
```

## user/xenomai/xenomai-2.4.x/ksrc/nucleus/Config.in
```kconfig
#
# Xenomai nucleus configuration for Linux v2.4
#

if [ "$CONFIG_XENOMAI" = "y" ]; then

dep_tristate 'Nucleus' CONFIG_XENO_OPT_NUCLEUS $CONFIG_XENOMAI

if [ "$CONFIG_XENO_OPT_NUCLEUS" != "n" ]; then
	mainmenu_option next_comment
	comment 'Nucleus options'
	bool 'Pervasive real-time support in user-space' CONFIG_XENO_OPT_PERVASIVE
	if [ "$CONFIG_XENO_OPT_PERVASIVE" != "n" ]; then
		bool 'Priority coupling support' CONFIG_XENO_OPT_PRIOCPL
	fi
	bool 'Message pipes' CONFIG_XENO_OPT_PIPE
	if [ "$CONFIG_XENO_OPT_PIPE" != "n" ]; then
		int 'Number of pipe devices' CONFIG_XENO_OPT_PIPE_NRDEV 32
	fi
	if [ "$CONFIG_XENO_OPT_PERVASIVE" != "n" ]; then
		define_bool CONFIG_XENO_OPT_REGISTRY y
	else
		bool 'Registry support' CONFIG_XENO_OPT_REGISTRY
	fi
	if [ "$CONFIG_XENO_OPT_REGISTRY" != "n" ]; then
		int 'Number of registry slots' CONFIG_XENO_OPT_REGISTRY_NRSLOTS 512
	fi
	int 'Size of the system heap (Kb)' CONFIG_XENO_OPT_SYS_HEAPSZ 128
	bool 'Interrupt shield support' CONFIG_XENO_OPT_ISHIELD
	bool 'Optimize as pipeline head' CONFIG_XENO_OPT_PIPELINE_HEAD
	bool 'Statistics collection' CONFIG_XENO_OPT_STATS
	bool 'Debug support' CONFIG_XENO_OPT_DEBUG
	if [ "$CONFIG_XENO_OPT_DEBUG" = "y" ]; then
		bool 'Nucleus Debugging support' CONFIG_XENO_OPT_DEBUG_NUCLEUS
		bool 'Queue Debugging support' CONFIG_XENO_OPT_DEBUG_QUEUES
		bool 'Watchdog support' CONFIG_XENO_OPT_WATCHDOG
		if [ "$CONFIG_XENO_OPT_WATCHDOG" = "y" ]; then
			int 'Watchdog timeout (seconds)' CONFIG_XENO_OPT_WATCHDOG_TIMEOUT 4
		fi
	fi

	bool 'Shared interrupts' CONFIG_XENO_OPT_SHIRQ
	bool 'Core support for select-like services' CONFIG_XENO_OPT_SELECT

	bool 'Enable periodic timing' CONFIG_XENO_OPT_TIMING_PERIODIC
	int 'Timer tuning latency (ns)' CONFIG_XENO_OPT_TIMING_TIMERLAT 0
	int 'Scheduling latency (ns)' CONFIG_XENO_OPT_TIMING_SCHEDLAT 0

	mainmenu_option next_comment
	comment 'Scalability options'
		bool 'O(1) scheduler' CONFIG_XENO_OPT_SCALABLE_SCHED
        choice 'Timer indexing method'			\
	"Linear			CONFIG_XENO_OPT_TIMER_LIST	\
	 Tree			CONFIG_XENO_OPT_TIMER_HEAP	\
	 Hash			CONFIG_XENO_OPT_TIMER_WHEEL"	Linear
	if [ "$CONFIG_XENO_OPT_TIMER_HEAP" = "y" ]; then
		int 'Max. number of timers' CONFIG_XENO_OPT_TIMER_HEAP_CAPACITY 256
	fi
	if [ "$CONFIG_XENO_OPT_TIMER_WHEEL" = "y" ]; then
		int 'Timer wheel step (ns)' CONFIG_XENO_OPT_TIMER_WHEEL_STEP 100000
	fi
	endmenu

	endmenu
fi

fi
```
