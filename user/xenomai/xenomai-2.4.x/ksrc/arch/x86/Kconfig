## user/xenomai/xenomai-2.4.x/ksrc/skins/posix/Kconfig
```kconfig
menuconfig XENO_SKIN_POSIX
	depends on XENO_OPT_NUCLEUS 
	tristate "POSIX API"
	default y
	help

	A POSIX-compliant skin.

if XENO_SKIN_POSIX

config XENO_OPT_POSIX_PERIOD
	int "Base period (us)" if XENO_OPT_TIMING_PERIODIC
	default 0
	help
	Duration of the base periodic tick (in microseconds).

	The POSIX skin can express all delays and timeouts either as
	counts of ticks (i.e. jiffy-based), or directly in
	nanoseconds in a tick-less fashion. This paramater defines the
	duration of the base period in microseconds; a null value
	selects the tick-less mode.

	The base period can be overriden at runtime using the
	"tick_arg" module parameter when loading the POSIX skin.

	If in doubt, leave zero in this field.

config XENO_OPT_POSIX_SHM
	bool "Shared memory"
	help

	POSIX skin shared memory areas are regions of memory which can be shared
	between kernel-space and user-space, or used to share synchronization
	objects between kernel-space and user-space.

	If you do not intend to use Xenomai POSIX skin in kernel-space (and
	using the RTDM skin is the preferred way of implementing drivers), leave
	this option unselected.

config XENO_OPT_POSIX_INTR
	bool "Interrupts"
	help

	This option provides an ad-hoc API to deal with interrupts in programs
	using Xenomai POSIX skin, both in kernel and user-space contexts. If you
	do not intend to handle interrupts in POSIX skin programs (and using the
	RTDM skin is the preferred way of implementing drivers), leave this
	option unselected.

if XENO_SKIN_POSIX = y && XENO_SKIN_RTDM = m
	comment "Note: Support for select is not available if the POSIX skin"
	comment "is built-in and the RTDM skin is compiled as a module."
endif

config XENO_OPT_POSIX_SELECT
	bool "Select syscall"
	select XENO_OPT_SELECT
	depends on XENO_SKIN_POSIX != y || XENO_SKIN_RTDM != m
	help

	This option allows applications using the Xenomai POSIX skin in
	user-space to use the "select" syscall with Xenomai POSIXK skin file
	descriptors.

config XENO_OPT_DEBUG_POSIX
	bool "Debugging support"
	default y
	help

	When enabled, this option makes the skin warn about not properly
	cleaned up POSIX objects it detects on process termination.

endif
```

## vendors/config/bfin/Kconfig
```kconfig
menu "Blackfin build options"

choice
	prompt "Binary format"
	default FMT_USE_FLAT

config FMT_USE_FLAT
	bool "FLAT"
	help
	  Build all libraries and applicaions to produce flat binaries.
	  FLAT binaries tend to be smaller. Their load time tend to be shorter.
	  This option must match the choice made for the C library; when configuring
	  uClibc, select the 'bfin' target.

config FMT_USE_SEP_DATA
	bool "Sep-Data"

config FMT_USE_SHARED_FLAT
	bool "Shared-FLAT"
	select INSTALL_FLAT_SHARED_LIBS
	help
	  Build all libraries and applicaions with -mid-shared-library.
	  This option must match the choice made for the C library; when configuring
	  uClibc, select the 'bfin' target.

config FMT_USE_FDPIC_ELF
	bool "FDPIC"
	select INSTALL_ELF_SHARED_LIBS
	help
	  Build all libraries and applicaions with -mfdpic to produce ELF binaries
	  rather than the default flat binaries.  ELF binaries tend to be larger,
	  but have more capabilities, such as support for dlopen.
	  This option must match the choice made for the C library; when configuring
	  uClibc, select either the 'bfin' target for flat binaries, or 'bfinfdpic'
	  for ELF.

endchoice

config INSTALL_ELF_SHARED_LIBS
	bool "Install ELF shared libraries"
	help
	  If you wish to use some ELF binaries on a system with mostly flat binaries,
	  enable this option to get the shared libraries from the toolchain
	  distribution installed in the romfs.

config INSTALL_ELF_TRIM_LIBS
	bool "Cull unused ELF shared libraries"
	default n
	depends INSTALL_ELF_SHARED_LIBS
	help
	  Automatically scan the romfs/ directory and remove all ELF libraries that
	  are not explicitly required by other ELF binaries.

	  Note: this requires "scanelf" from the "pax-utils" package:
	        http://hardened.gentoo.org/pax-utils.xml

config INSTALL_FLAT_SHARED_LIBS
	bool "Install FLAT shared libraries"
	help
	  If the majority of binaries in your system uses either static flat or ELF
	  binaries, but there are some applications built against shared flat
	  libraries, enable this option to get the shared flat libraries from the
	  toolchain distribution installed in the romfs.

config USER_CFLAGS
	string "User/Lib CFLAGS"
	default "-g -O2"
	depends !LIB_DEBUG && !USER_DEBUG

config BLACKFIN_CHECK_STACKFLOW
	bool "build with stack overflow checking"
	help
	  Build all libraries and applicaions with -mstack-check-l1.

config BLACKFIN_CHECK_POINTER
	bool "build with mudflap pointer checking"

config BLACKFIN_INSTALL_UCLINUX_CONFIG
	bool "install uClinux-dist .config into /root"

endmenu
```
