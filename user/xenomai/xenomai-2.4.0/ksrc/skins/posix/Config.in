## user/xenomai/xenomai-2.4.0/ksrc/skins/uitron/Kconfig
```kconfig
menuconfig XENO_SKIN_UITRON
	depends on XENO_OPT_NUCLEUS
	select XENO_OPT_TIMING_PERIODIC
	select XENO_OPT_MAP
	tristate "uITRON API"
	help

	This skin implements the uITRON API. 

config XENO_OPT_UITRON_PERIOD
	depends on XENO_SKIN_UITRON
	int "Base period (us)"
	default 1000
	help
	Duration of the base periodic tick (in microseconds).

	The uITRON skin expresses all delays and timeouts as
	counts of ticks. This parameter defines the duration
	of a uITRON clock tick expressed in microseconds.

	The base period can be overriden at runtime using the
	"tick_arg" module parameter when loading the uITRON skin.
```

## user/xenomai/xenomai-2.4.0/ksrc/skins/vrtx/Kconfig
```kconfig
menuconfig XENO_SKIN_VRTX
	depends on XENO_OPT_NUCLEUS
	select XENO_OPT_TIMING_PERIODIC
	select XENO_OPT_MAP
	tristate "VRTX emulator"
	select XENO_OPT_REGISTRY if XENO_OPT_PERVASIVE
	help

	This API skin emulates Mentor Graphics's VRTX operating
	system.

config XENO_OPT_VRTX_PERIOD
	depends on XENO_SKIN_VRTX
	int "Base period (us)"
	default 1000
	help
	Duration of the base periodic tick (in microseconds).

	The VRTX skin expresses all delays and timeouts as
	counts of ticks. This parameter defines the duration
	of a VRTX clock tick expressed in microseconds.

	The base period can be overriden at runtime using the
	"tick_arg" module parameter when loading the VRTX skin.
```

## user/xenomai/xenomai-2.4.7/ksrc/Config.in
```kconfig
#
# Xenomai configuration for Linux v2.4
#

source kernel/xenomai/nucleus/Config.in
source kernel/xenomai/skins/Config.in
source drivers/xenomai/Config.in
```

## user/xenomai/xenomai-2.4.7/ksrc/arch/ia64/Kconfig
```kconfig
source "kernel/xenomai/nucleus/Kconfig"

menu "Machine"

depends on XENO_OPT_NUCLEUS

config XENO_HW_IA64_STACK_POOL
        int "Number of pre-allocated kernel stacks"
        default 4
        help
	The current implementation for the Itanium architecture
	requires that stacks of Xenomai threads running in kernel
	space be pre-allocated in a separate pool. This parameter
	allows to set the size of this stack spool, which consequently
	defines the maximum number of concurrently runnable
	kernel-based threads at any point in time. Nb: Xenomai
	threads running in user-space are _not_ impacted by this
	limit.

endmenu

source "kernel/xenomai/skins/Kconfig"
source "drivers/xenomai/Kconfig"
```

## user/xenomai/xenomai-2.4.7/ksrc/arch/powerpc/Config.in
```kconfig
mainmenu_option next_comment
comment 'Real-time sub-system'

if [ "$CONFIG_IPIPE" = "n" ]; then
    comment "Xenomai depends on Adeos interrupt pipeline"
else
    bool 'Xenomai' CONFIG_XENOMAI

    source kernel/xenomai/Config.in

    if [ "$CONFIG_XENOMAI" = "y" -a "$CONFIG_XENO_OPT_NUCLEUS" != "n" ]; then
	mainmenu_option next_comment
	comment 'Machine'
	bool 'Enable FPU support' CONFIG_XENO_HW_FPU
	endmenu
    fi
fi

endmenu
```

## user/xenomai/xenomai-2.4.7/ksrc/arch/x86/Config.in
```kconfig
mainmenu_option next_comment
comment 'Real-time sub-system'

if [ "$CONFIG_APM" = "m" -o "$CONFIG_APM" = "y" -o "$CONFIG_ACPI_PROCESSOR" = "y" -o "$CONFIG_ACPI_PROCESSOR" = "m" ]; then
    comment "WARNING! You enabled APM or ACPI 'processor' option"
    comment "These options are known to cause troubles with Xenomai"
fi

if [ "$CONFIG_IPIPE" = "n" ]; then
    comment "Xenomai depends on Adeos interrupt pipeline"
else
    bool 'Xenomai' CONFIG_XENOMAI

    source kernel/xenomai/Config.in

    if [ "$CONFIG_XENOMAI" = "y" -a "$CONFIG_XENO_OPT_NUCLEUS" != "n" ]; then

	mainmenu_option next_comment
	comment 'Machine'
	bool 'Enable FPU support' CONFIG_XENO_HW_FPU

	if [ "$CONFIG_X86_LOCAL_APIC" = "y" ]; then
	   mainmenu_option next_comment
	   comment 'NMI watchdog'
	   bool 'Enable NMI watchdog' CONFIG_XENO_HW_NMI_DEBUG_LATENCY
	   if [ "$CONFIG_XENO_HW_NMI_DEBUG_LATENCY" != "n" ]; then
	       int 'NMI watchdog latency threshold (us)' CONFIG_XENO_HW_NMI_DEBUG_LATENCY_MAX 0
	   fi
	   endmenu
	fi
	mainmenu_option next_comment
	comment 'SMI workaround'
	bool 'Disable SMI detection' CONFIG_XENO_HW_SMI_DETECT_DISABLE
	if [ "$CONFIG_XENO_HW_SMI_DETECT_DISABLE" != "y" ]; then
	   define_bool CONFIG_XENO_HW_SMI_DETECT y
	   bool 'Enable SMI workaround' CONFIG_XENO_HW_SMI_WORKAROUND
	   if [ "$CONFIG_XENO_HW_SMI_WORKAROUND" != "n" ]; then
	      bool 'Globally disable SMI' CONFIG_XENO_HW_SMI_ALL
	      if [ "$CONFIG_XENO_HW_SMI_ALL" != "y" ]; then
	         bool 'Enable Intel-Specific USB2 SMI' CONFIG_XENO_HW_SMI_INTEL_USB2
	         bool 'Enable legacy USB2 SMI' CONFIG_XENO_HW_SMI_LEGACY_USB2
	         bool 'Enable periodic SMI' CONFIG_XENO_HW_SMI_PERIODIC
	         bool 'Enable TCO SMI' CONFIG_XENO_HW_SMI_TCO
	         bool 'Enable microcontroller SMI' CONFIG_XENO_HW_SMI_MC
	         bool 'Enable APM SMI' CONFIG_XENO_HW_SMI_APMC
	         bool 'Enable legacy USB SMI' CONFIG_XENO_HW_SMI_LEGACY_USB
	         bool 'Enable ACPI BIOS SMI' CONFIG_XENO_HW_SMI_BIOS
              fi
	   fi
	fi
	endmenu
	endmenu
    fi
fi

endmenu
```

## user/xenomai/xenomai-2.4.7/ksrc/drivers/Config.in
```kconfig
#
# Xenomai configuration for Linux v2.4
#

if [ "$CONFIG_XENOMAI" = "y" \
     -a "$CONFIG_XENO_OPT_NUCLEUS" != "n" \
     -a "$CONFIG_XENO_SKIN_RTDM" != "n" ]; then
mainmenu_option next_comment
comment 'Drivers'
	source drivers/xenomai/serial/Config.in
	source drivers/xenomai/testing/Config.in
	source drivers/xenomai/can/Config.in
endmenu
fi
```

## user/xenomai/xenomai-2.4.7/ksrc/drivers/Kconfig
```kconfig
menu "Drivers"

depends on XENO_OPT_NUCLEUS

source "drivers/xenomai/serial/Kconfig"
source "drivers/xenomai/testing/Kconfig"
source "drivers/xenomai/can/Kconfig"

endmenu
```

## user/xenomai/xenomai-2.4.7/ksrc/drivers/can/Config.in
```kconfig
#
# Xenomai configuration for Linux v2.4
#

mainmenu_option next_comment
comment 'CAN drivers'

dep_tristate 'RT-Socket-CAN, CAN raw socket interface' CONFIG_XENO_DRIVERS_CAN $CONFIG_XENO_SKIN_RTDM

if [ "$CONFIG_XENO_DRIVERS_CAN" != "n" ]; then 
   bool 'Enable debug output' CONFIG_XENO_DRIVERS_CAN_DEBUG
   bool 'Enable TX loopback to local sockets' CONFIG_XENO_DRIVERS_CAN_LOOPBACK
   int 'Size of receive ring buffers (must be 2^N)' CONFIG_XENO_DRIVERS_CAN_RXBUF_SIZE 1024
   int 'Maximum number of devices' CONFIG_XENO_DRIVERS_CAN_MAX_DEVICES 4
   int 'Maximum number of receive filters per device' CONFIG_XENO_DRIVERS_CAN_MAX_RECEIVERS 16

   dep_tristate 'Virtual CAN bus driver' CONFIG_XENO_DRIVERS_CAN_VIRT $CONFIG_XENO_DRIVERS_CAN

   source drivers/xenomai/can/mscan/Config.in
   source drivers/xenomai/can/sja1000/Config.in

fi

endmenu
```

## user/xenomai/xenomai-2.4.7/ksrc/drivers/can/mscan/Config.in
```kconfig
#
# Xenomai configuration for Linux v2.4
#

if [ "$CONFIG_MPC5200" = "y" ]; then

dep_tristate 'MSCAN driver for MPC5200' CONFIG_XENO_DRIVERS_CAN_MSCAN $CONFIG_XENO_DRIVERS_CAN

if [ "$CONFIG_XENO_DRIVERS_CAN_MSCAN" != "n" ]; then
    bool 'Enable CAN 1' CONFIG_XENO_DRIVERS_CAN_MSCAN_1
    bool 'Enable CAN 2' CONFIG_XENO_DRIVERS_CAN_MSCAN_2
    int 'Clock Frequency in Hz' CONFIG_XENO_DRIVERS_CAN_MSCAN_CLOCK 66000000
    choice 'Pin Configuration' \
    "I2C1/TMR01 CONFIG_XENO_DRIVERS_CAN_MSCAN_ALT \
     PSC2       CONFIG_XENO_DRIVERS_CAN_MSCAN_PSC2" I2C1/TMR01
fi

fi
```

## user/xenomai/xenomai-2.4.7/ksrc/drivers/serial/Config.in
```kconfig
#
# Xenomai configuration for Linux v2.4
#

mainmenu_option next_comment
comment 'Serial drivers'

dep_tristate '16550A compatible UARTs' CONFIG_XENO_DRIVERS_16550A $CONFIG_XENO_SKIN_RTDM

if [ "$CONFIG_XENO_DRIVERS_16550A" != "n" ]; then
	choice 'Hardware access mode'	\
	"Port-based		CONFIG_XENO_DRIVERS_16550A_PIO	\
	 Memory-mapped		CONFIG_XENO_DRIVERS_16550A_MMIO	\
	 Any			CONFIG_XENO_DRIVERS_16550A_ANY" Port-based
fi

endmenu
```

## user/xenomai/xenomai-2.4.7/ksrc/drivers/testing/Kconfig
```kconfig
menu "Testing drivers"

config XENO_KLATENCY_MODULE
        depends on MODULES
	def_tristate m

config XENO_DRIVERS_TIMERBENCH
	depends on XENO_SKIN_RTDM
	tristate "Timer benchmark driver"
	help
	Kernel-based benchmark driver for timer latency evaluation.
	See testsuite/latency for a possible front-end.

config XENO_DRIVERS_KLATENCY
	depends on XENO_DRIVERS_TIMERBENCH && XENO_KLATENCY_MODULE
	tristate "Kernel-only latency measurement module"
	help
	Kernel module for kernel-only latency measurement.

config XENO_DRIVERS_IRQBENCH
	depends on XENO_SKIN_RTDM
	tristate "IRQ benchmark driver"
	help
	Loopback driver for IRQ latency evaluation over serial or parallel
	port links. Additionally requires user-space helper and a logging tool
	(see testsuite/irqbench).

config XENO_DRIVERS_SWITCHTEST
	depends on XENO_SKIN_RTDM
	tristate "Context switch unit testing driver"
	help
	Kernel-based driver for unit testing context switches and
	FPU switches.

endmenu
```

## user/xenomai/xenomai-2.4.7/ksrc/skins/Config.in
```kconfig
#
# Xenomai configuration for Linux v2.4
#

if [ "$CONFIG_XENOMAI" = "y" -a "$CONFIG_XENO_OPT_NUCLEUS" != "n" ]; then
mainmenu_option next_comment
comment 'Interfaces'
source kernel/xenomai/skins/native/Config.in
source kernel/xenomai/skins/posix/Config.in
source kernel/xenomai/skins/rtdm/Config.in
source kernel/xenomai/skins/psos+/Config.in
source kernel/xenomai/skins/vxworks/Config.in
source kernel/xenomai/skins/vrtx/Config.in
source kernel/xenomai/skins/uitron/Config.in
source kernel/xenomai/skins/rtai/Config.in
endmenu
fi
```

## user/xenomai/xenomai-2.4.7/ksrc/skins/Kconfig
```kconfig
menu "Interfaces"

depends on XENO_OPT_NUCLEUS

source "kernel/xenomai/skins/native/Kconfig"
source "kernel/xenomai/skins/posix/Kconfig"
source "kernel/xenomai/skins/psos+/Kconfig"
source "kernel/xenomai/skins/uitron/Kconfig"
source "kernel/xenomai/skins/vrtx/Kconfig"
source "kernel/xenomai/skins/vxworks/Kconfig"
source "kernel/xenomai/skins/rtai/Kconfig"
source "kernel/xenomai/skins/rtdm/Kconfig"

endmenu
```

## user/xenomai/xenomai-2.4.7/ksrc/skins/native/Kconfig
```kconfig
menuconfig XENO_SKIN_NATIVE
	depends on XENO_OPT_NUCLEUS
	tristate "Native API"
	default y
	help

	The native Xenomai API.

if XENO_SKIN_NATIVE

config XENO_OPT_NATIVE_PERIOD
	int "Base period (us)" if XENO_OPT_TIMING_PERIODIC
	default 0
	help
	Duration of the base periodic tick (in microseconds).

	The native skin can express all delays and timeouts either as
	counts of ticks (i.e. jiffy-based), or directly in
	nanoseconds in a tick-less fashion. This paramater defines the
	duration of the base period in microseconds; a null value
	selects the tick-less mode.

	The base period can be overriden at runtime using the
	"tick_arg" module parameter when loading the native skin.

	If in doubt, leave zero in this field.

config XENO_OPT_NATIVE_PIPE
	bool "Message pipes"
	select XENO_OPT_PIPE
	default y
	help
	
	Message pipes are bi-directional FIFO communication
	channels allowing data exchange between real-time tasks
	and regular user-space processes. Pipes natively preserve
	message boundaries, but can also be used in byte stream mode
	from kernel to user space.

	The maximum number of pipes available in the system can be
	configured using the XENO_OPT_PIPE_NRDEV option from the
	Nucleus menu.

config XENO_OPT_NATIVE_PIPE_BUFSZ
	int "Bytes in buffer space"
	depends on XENO_OPT_NATIVE_PIPE
	default 1024
	help
	
	This option sets the memory size available for per-pipe
	buffering when message pipes are used in byte stream mode.

config XENO_OPT_NATIVE_REGISTRY
	bool
	prompt "Registry support" if !XENO_OPT_PERVASIVE
	select XENO_OPT_REGISTRY
	default y
	help
	
	The registry is used to bind real-time objects to symbolic names,
	so that these objects can be further retrieved and shared by
	real-time applications regardless of their runtime space (i.e.
	kernel or user). Each named object occupies a registry slot.

config XENO_OPT_NATIVE_SEM
	bool "Counting semaphores"
	default y
	help
	
	Counting semaphore are synchronization objects granting Xenomai
	tasks a concurrent access to a given number of resources
	maintained in an internal counter variable.

config XENO_OPT_NATIVE_EVENT
	bool "Event flags"
	default y
	help
	
	Event flag groups are synchronization objects represented by a
	long-word structure; every available bit in such word can be used
	to map a user-defined event flag Xenomai tasks can wait for.

config XENO_OPT_NATIVE_MUTEX
	bool "Mutexes"
	default y if XENO_OPT_NATIVE_COND
	help
	
	Mutexes are MUTual EXclusion objects, useful for protecting
	shared data structures from concurrent modifications, and
	implementing critical sections and monitors.

config XENO_OPT_NATIVE_COND
	bool "Condition variables"
	default y
	help
	
	Condition variables are synchronization objects which
	allow Xenomai tasks to suspend execution until some predicate on
	shared data is satisfied. 

config XENO_OPT_NATIVE_QUEUE
	bool "Message queues"
	default y
	help
	
	Message queueing is a method by which real-time tasks can
	exchange or pass data through a xeno-managed queue of
	messages. Messages can vary in length and be assigned
	different types or usages.

config XENO_OPT_NATIVE_HEAP
	bool "Memory heaps"
	default y
	help

	Memory heaps are regions of memory used for dynamic memory
	allocation in a time-bounded fashion.

config XENO_OPT_NATIVE_ALARM
	bool "Alarms"
	default y
	help
	
	Alarms are general watchdog timers allowing to run
	user-defined handlers after a specified delay has elapsed.

config XENO_OPT_NATIVE_MPS
	bool "Message passing support"
	default y
	help
	
	This simple message passing interface allows to exchange
	variable-sized messages in a synchronous fashion between Xenomai
	tasks.

config XENO_OPT_NATIVE_INTR
	bool "Interrupts"
	help
	
	This option provides a simple API to deal with interrupts,
	both in kernel and user-space contexts. Note that the preferred
	way of implementing generic drivers usable across all Xenomai
	interfaces is defined by the Real-Time Driver Model (RTDM).

config XENO_OPT_DEBUG_NATIVE
	bool "Debugging support"
	depends on XENO_OPT_DEBUG
	default y
	help

	When enabled, this option makes the skin warn about
	auto-clean operations executed upon process termination.

endif
```

## user/xenomai/xenomai-2.4.7/ksrc/skins/psos+/Kconfig
```kconfig
menuconfig XENO_SKIN_PSOS
	depends on XENO_OPT_NUCLEUS
	select XENO_OPT_TIMING_PERIODIC
	tristate "pSOS+ emulator"
	select XENO_OPT_REGISTRY if XENO_OPT_PERVASIVE
	help

	This API skin emulates WindRiver's pSOS+ operating system.

if XENO_SKIN_PSOS

config XENO_OPT_PSOS_PERIOD
	int "Base period (us)"
	default 1000
	help
	Duration of the base periodic tick (in microseconds).

	The pSOS skin expresses all delays and timeouts as
	counts of ticks. This parameter defines the duration
	of a pSOS clock tick expressed in microseconds.

	The base period can be overriden at runtime using the
	"tick_arg" module parameter when loading the pSOS skin.

config XENO_OPT_DEBUG_PSOS
	bool "Debugging support"
	depends on XENO_OPT_DEBUG
	default y
	help

	When enabled, this option makes the skin warn about
	auto-clean operations executed upon process termination.

endif
```
