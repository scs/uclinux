## linux-2.6.x/arch/blackfin/Kconfig.ide
```kconfig
# uClinux Blackfin Target Board Selection Menu (IDE)

if (BFIN)
menu "IDE Extra configuration"

config BFIN_IDE_BASE
	hex "IDE register base address"
	depends on IDE
	default 0x20304020
	help
	  IDE registers base address

config BFIN_IDE_ALT
	hex "IDE register alternate address"
	depends on IDE
	default 0x2030401C
	help
	  IDE alternate registers address

config BFIN_IDE_IRQ
	int "IDE IRQ no"
	depends on IDE
	default "34" if BFIN537_STAMP
	default "26" if BFIN533_STAMP
	help
	  IDE use IRQ no IRQ_PROG_INTA

config BFIN_IDE_IRQ_PFX
	int "IDE IRQ PFx no"
	depends on IDE
	default 55
	help
	  IDE IRQ use PFx

choice
	prompt	"IDE Interface Address Mapping (see help)"
	default BFIN_IDE_ADDRESS_MAPPING_MODE0

config BFIN_IDE_ADDRESS_MAPPING_MODE0
	bool "Linear 16-bit mapping with reg spacing"
	help
	  Blackfin 	HDD
	  A1 	  -->	A0
	  A2	  -->	A1
	  A3	  -->	A2
	  A4 +AMSx  -->	/CS0
	  A5 +AMSx  -->	/CS1
	  /ARE	  -->	/IOR
	  /AWE	  -->	/IOW
	  PFx	  <--	/INTRQ
	  /RESET	  -->	/RESET
	  D[0..15]  <->	D[0..15]
	
	  For CF Cards in TRUE IDE MODE only
	  VCC	  <--	/REG
	  VCC	  <--	/WE
	  GND	  <--	/ATA_SEL

config BFIN_IDE_ADDRESS_MAPPING_MODE1
	bool "16-bit mapping for multimode CF Interface"
	help
	  Blackfin 	HDD
	  Ax 	  -->	A0
	  A1	  -->	A1
	  A2	  -->	A2
	  A4 +AMSx  -->	/CS0
	  A5 +AMSx  -->	/CS1
	  /ARE	  -->	/IOR
	  /AWE	  -->	/IOW
	  PFx	  <--	/INTRQ
	  /RESET	  -->	/RESET
	  D[0..15]  <->	D[0..15]
	
	  For CF Cards in TRUE IDE MODE only
	  VCC	  <--	/REG
	  VCC	  <--	/WE
	  GND	  <--	/ATA_SEL
endchoice

config BFIN_IDE_ADDRESS_AX
	int "Blackfin A[x] used as CF A0"
	depends on BFIN_IDE_ADDRESS_MAPPING_MODE1
	default 13
	help

endmenu
endif
```

## linux-2.6.x/arch/sh/drivers/dma/Kconfig
```kconfig
config SH_DMA
	bool "DMA controller (DMAC) support"
	help
	  Selecting this option will provide same API as PC's Direct Memory
	  Access Controller(8237A) for SuperH DMAC.

	  If unsure, say N.

config NR_DMA_CHANNELS
	int "Maximum number of DMA channels"
	depends on SH_DMA
	default "4"
	help
	  This allows you to specify the maximum number of DMA channels to
	  support. This will be 4 for SH7750/SH7751 and 8 for SH7750R/SH7751R
	  if only supporting the on-chip DMAC. Setting this to a higher value
	  allows for cascading DMACs with additional channels.

config DMA_PAGE_OPS
	bool "Use DMAC for page copy/clear"
	depends on SH_DMA
	help
	  Selecting this option will use a dual-address mode configured channel
	  in the SH DMAC for copy_page()/clear_page(). Primarily a performance
	  hack.
```

## linux-2.6.x/drivers/char/can4linux/Kconfig
```kconfig
#
# CAN interface boards configuration
#

menu "CAN, the car bus and industrial fieldbus"

config CAN4LINUX
	bool "can4linux support, the car bus and industrial fieldbus"
	---help---
	  can4linux is a special driver for the CAN chips of different
	  manufacturers. It currently supports the stand-alone
	  Philips SJA1000, Intel 82527 and Infineon TwinCAN (SAK82C900).
	  On Motorola ColdFire the integrated FlexCAN is supported.
	  On Analog Devices BlackFin the integrated CAN is supported.
  
	  If you have one of the mentioned controllers and want to have
	  driver support for CAN, say Y here.


#
# ISA-based CAN Cards
#

comment "ISA-based CAN Cards"
	depends on CAN4LINUX && ISA

config CAN_ATCANMINI
	tristate "port GmbH ISA AT-CAN-MINI 1 channel CAN high speed interface"
	depends on CAN4LINUX && ISA
	---help---
	  Simply say Y to enable support for this board.
	  Driver supports the SJA1000 PeliCAN mode

#
# PCI-based CAN Cards
#

comment "PCI-based CAN Cards"
	depends on CAN4LINUX && PCI

config CAN_CPC_PCI
	tristate "EMS Wuensche CPC-PCI 2 channel CAN high speed interface"
	depends on CAN4LINUX && PCI
	---help---
	  Simply say Y to enable support for this board.
	  Driver supports the SJA1000 PeliCAN mode

#
# USB-based CAN Cards
#

comment "USB-based CAN Cards"
	depends on CAN4LINUX && USB

#
# USB-based CAN Cards
#

#
# special CAN drivers found on embedded hardware (microcontrollers)
#

comment "linux embedded drivers"
	depends on CAN4LINUX && EMBEDDED

config CAN_MCF5282
	tristate "Motorola ColdFire MFC5282 FlexCAN driver"
	depends on CAN4LINUX && EMBEDDED
	---help---
	  help text

config CAN_UNCTWINCAN
	tristate "Infineon TwinCAN SAK82c900 on Flesch UNC20"
	depends on CAN4LINUX && EMBEDDED
	---help---
	  help text

config CAN_BLACKFIN
	tristate "Analog Devices BlackFin CAN Controller"
	depends on CAN4LINUX && EMBEDDED
	---help---
	  This is can4linux support for the integrated CAN controller
	  found on Analog Devices BlackFin processors.

endmenu
```

## linux-2.6.x/drivers/ide/blackfin/Kconfig.ide
```kconfig
# uClinux Blackfin Target Board Selection Menu (IDE)

choice
	prompt "IDE Interface Address Mapping (see help)"
	depends on IDE_BFIN
	default BFIN_IDE_ADDRESS_MAPPING_MODE0

config BFIN_IDE_ADDRESS_MAPPING_MODE0
	bool "Linear 16-bit mapping with reg spacing"
	help
	  Blackfin        HDD
	  A1        -->   A0
	  A2        -->   A1
	  A3        -->   A2
	  A4 +AMSx  -->   /CS0
	  A5 +AMSx  -->   /CS1
	  /ARE      -->   /IOR
	  /AWE      -->   /IOW
	  PFx       <--   /INTRQ
	  /RESET    -->   /RESET
	  D[0..15]  <->   D[0..15]

	  For CF Cards in TRUE IDE MODE only
	  VCC       <--   /REG
	  VCC       <--   /WE
	  GND       <--   /ATA_SEL

config BFIN_IDE_ADDRESS_MAPPING_MODE1
	bool "16-bit mapping for multimode CF Interface"
	help
	  Blackfin        HDD
	  Ax        -->   A0
	  A1        -->   A1
	  A2        -->   A2
	  A4 +AMSx  -->   /CS0
	  A5 +AMSx  -->   /CS1
	  /ARE      -->   /IOR
	  /AWE      -->   /IOW
	  PFx       <--   /INTRQ
	  /RESET    -->   /RESET
	  D[0..15]  <->   D[0..15]

	  For CF Cards in TRUE IDE MODE only
	  VCC       <--   /REG
	  VCC       <--   /WE
	  GND       <--   /ATA_SEL

endchoice

config BFIN_IDE_BASE
	hex "IDE register base address"
	depends on BFIN_IDE_ADDRESS_MAPPING_MODE0 || BFIN_IDE_ADDRESS_MAPPING_MODE1
	default "0x20314020" if (BFIN_IDE_ADDRESS_MAPPING_MODE0 && (BFIN537_STAMP || BFIN533_STAMP || BF533_EZKIT || BF561_EZKIT))
	default "0x2031C020" if (BFIN_IDE_ADDRESS_MAPPING_MODE1 && (BFIN537_STAMP || BFIN533_STAMP || BF533_EZKIT || BF561_EZKIT))
	default "0x2030C000" if (BFIN_IDE_ADDRESS_MAPPING_MODE0 && (BFIN533_BLUETECHNIX_CM || BFIN537_BLUETECHNIX_CM))
	default "0x2400C000" if (BFIN_IDE_ADDRESS_MAPPING_MODE0 && BFIN561_BLUETECHNIX_CM)
	help
	  IDE registers base address
	  default "0x20314020" if BFIN_IDE_ADDRESS_MAPPING_MODE0
	  default "0x2031C020" if BFIN_IDE_ADDRESS_MAPPING_MODE1

config BFIN_IDE_ALT
	hex "IDE register alternate address"
	depends on BFIN_IDE_ADDRESS_MAPPING_MODE0 || BFIN_IDE_ADDRESS_MAPPING_MODE1
	default "0x2031401C" if (BFIN_IDE_ADDRESS_MAPPING_MODE0 && (BFIN537_STAMP || BFIN533_STAMP || BF533_EZKIT || BF561_EZKIT))
	default "0x2031C016" if (BFIN_IDE_ADDRESS_MAPPING_MODE1 && (BFIN537_STAMP || BFIN533_STAMP || BF533_EZKIT || BF561_EZKIT))
	default "0x2030D018" if (BFIN_IDE_ADDRESS_MAPPING_MODE0 && (BFIN533_BLUETECHNIX_CM || BFIN537_BLUETECHNIX_CM))
	default "0x2400D018" if (BFIN_IDE_ADDRESS_MAPPING_MODE0 && BFIN561_BLUETECHNIX_CM)
	help
	  IDE alternate registers address
	  default "0x2031401C" if BFIN_IDE_ADDRESS_MAPPING_MODE0
	  default "0x2031C01C" if BFIN_IDE_ADDRESS_MAPPING_MODE1

config BFIN_IDE_IRQ_PFX
	int "IDE IRQ_PFx number"
	depends on BFIN_IDE_ADDRESS_MAPPING_MODE0 || BFIN_IDE_ADDRESS_MAPPING_MODE1
	range 33 120
	default "55" if (BFIN_IDE_ADDRESS_MAPPING_MODE0 && (BFIN537_STAMP || BFIN533_STAMP || BF533_EZKIT || BF561_EZKIT))
	default "54" if (BFIN_IDE_ADDRESS_MAPPING_MODE1 && (BFIN537_STAMP || BFIN533_STAMP || BF533_EZKIT || BF561_EZKIT))
	default "38" if (BFIN_IDE_ADDRESS_MAPPING_MODE0 && BFIN533_BLUETECHNIX_CM)
	default "64" if (BFIN_IDE_ADDRESS_MAPPING_MODE0 && BFIN537_BLUETECHNIX_CM)
	default "119" if (BFIN_IDE_ADDRESS_MAPPING_MODE0 && BFIN561_BLUETECHNIX_CM)
	help

config BFIN_IDE_GAP
	int "Address Stride / IDE GAP"
	depends on BFIN_IDE_ADDRESS_MAPPING_MODE0
	default 2 if (BFIN_IDE_ADDRESS_MAPPING_MODE0 && (BFIN537_STAMP || BFIN533_STAMP || BF533_EZKIT || BF561_EZKIT))
	default 4 if (BFIN_IDE_ADDRESS_MAPPING_MODE0 && (BFIN533_BLUETECHNIX_CM || BFIN561_BLUETECHNIX_CM || BFIN537_BLUETECHNIX_CM))
	help

config BFIN_IDE_ADDRESS_AX
	int "Blackfin A[x] used as CF A0"
	depends on BFIN_IDE_ADDRESS_MAPPING_MODE1
	default 13
	help

config CF_ATASEL_ENA
	hex "Address for enabling CF TRUE IDE MODE (ATASEL)"
	depends on BFIN_IDE_ADDRESS_MAPPING_MODE1
	default 0x20311802
	help

config CF_ATASEL_DIS
	hex "Address for disabling CF TRUE IDE MODE (ATASEL)"
	depends on BFIN_IDE_ADDRESS_MAPPING_MODE1
	default 0x20311800
	help
```

## linux-2.6.x/drivers/input/misc/Kconfig
```kconfig
#
# Input misc drivers configuration
#
menuconfig INPUT_MISC
	bool "Miscellaneous devices"
	help
	  Say Y here, and a list of miscellaneous input drivers will be displayed.
	  Everything that didn't fit into the other categories is here. This option
	  doesn't affect the kernel.

	  If unsure, say Y.

if INPUT_MISC

config INPUT_PCSPKR
	tristate "PC Speaker support"
	depends on ALPHA || X86 || MIPS || PPC_PREP || PPC_CHRP || PPC_PSERIES
	help
	  Say Y here if you want the standard PC Speaker to be used for
	  bells and whistles.

	  If unsure, say Y.

	  To compile this driver as a module, choose M here: the
	  module will be called pcspkr.

config INPUT_SPARCSPKR
	tristate "SPARC Speaker support"
	depends on PCI && SPARC64
	help
	  Say Y here if you want the standard Speaker on Sparc PCI systems
	  to be used for bells and whistles.

	  If unsure, say Y.

	  To compile this driver as a module, choose M here: the
	  module will be called sparcspkr.

config INPUT_M68K_BEEP
	tristate "M68k Beeper support"
	depends on M68K

config INPUT_WISTRON_BTNS
	tristate "x86 Wistron laptop button interface"
	depends on X86 && !X86_64
	help
	  Say Y here for support of Winstron laptop button interface, used on
	  laptops of various brands, including Acer and Fujitsu-Siemens.

	  To compile this driver as a module, choose M here: the module will
	  be called wistron_btns.

config INPUT_IXP4XX_BEEPER
	tristate "IXP4XX Beeper support"
	depends on ARCH_IXP4XX
	help
	  If you say yes here, you can connect a beeper to the
	  ixp4xx gpio pins. This is used by the LinkSys NSLU2.

	  If unsure, say Y.

	  To compile this driver as a module, choose M here: the
	  module will be called ixp4xx-beeper.

config INPUT_UINPUT
	tristate "User level driver support"
	help
	  Say Y here if you want to support user level drivers for input
	  subsystem accessible under char device 10:223 - /dev/input/uinput.

	  To compile this driver as a module, choose M here: the
	  module will be called uinput.

config HP_SDC_RTC
	tristate "HP SDC Real Time Clock"       
	depends on GSC
	select HP_SDC
	help
	  Say Y here if you want to support the built-in real time clock
	  of the HP SDC controller.

config BF53X_PFBUTTONS
	tristate "PF buttons input device"
	help
	  Say Y here if you want to support buttons by PF for input
	  subsystem. Proc interface (read only) - /proc/driver/bf53xPFbuttons.

	  To compile this driver as a module, choose M here: the
	  module will be called bf53x_pfbuttons.

config TWI_KEYPAD
	tristate "TWI/I2C Keypad input device"
	depends on I2C && EXPERIMENTAL
	help
	  Say Y here if you want to support a 4x4 keypad matrix for input
	  subsystem. The keypad is connetced via I2C with a PCF8574. 

	  To compile this driver as a module, choose M here: the
	  module will be called twi_keyqad.

config BFIN_TWIKEYPAD_IRQ_PFX
	int "GPIO for Interrupt"
	depends on (BFIN && TWI_KEYPAD)
	range 33 120
	default "72" if BFIN537_STAMP
	default "39" if BFIN533_STAMP
	help
	  Choose an GPIO as Keypad interrupt [33..120]


endif
```

## linux-2.6.x/drivers/media/video/blackfin/Kconfig
```kconfig
config VIDEO_BLACKFIN_MT9M001
	tristate "Micron Camera driver for BF537"
	depends on BFIN && VIDEO_DEV && I2C
	default n
	help
	  V4L Support for the Micron MT9M001 camera attached to
	  the Blackfin PPI.

	  To compile this driver as a module, choose M here: the
	  module will be called mt9m001.
```

## linux-2.6.x/drivers/mmc/spi_mmc/Kconfig
```kconfig
#
# SPI_MMC subsystem configuration
#

config SPI_MMC
	tristate "MMC/SD for SPI support (EXPERIMENTAL)"
        depends on EXPERIMENTAL && SPI
        default n
        ---help---
	MMC/SD card over SPI support.
	
	Say Y or M here if you want to attach an MMC/SD socket to the SPI port.
	The "MMC support" option does not need to be enabled for this driver to work.

	Read spi_mmc.txt documentation for details or more help.
	
config SPI_MMC_CS_CHAN
	int "SPI chip select signal for MMC/SD card"
	depends on SPI_MMC
	range 0 7
	default "4"
	help
	Set the Chip Select signal to use for the MMC/SD card.

config SPI_MMC_CARD_DETECT
	bool "MMC/SD Card detect support (EXPERIMENTAL)"
	depends on SPI_MMC && BFIN
	default "n"
	help
	Supported platforms can make use of card detect signal to sense insertion
	and removal of card. Hotplug events could be generated for userspace to
	take action, such as mounting partitions. Debug mode is not available
	with card detection.

config SPI_MMC_CARD_DETECT_PFLAG
	int "Card detect PFx number"
	depends on SPI_MMC_CARD_DETECT
	default "5"
	help
	Which PFx number to use for card detection.

config SPI_MMC_DEBUG_MODE
	bool "Print debug text on errors"
	depends on SPI_MMC && !SPI_MMC_CARD_DETECT
	default n
	---help---
	Will print verobse debug data during MMC/SD errors of any kind. Note that
	during card initialization errors are normal.
#endmenu
```
