## linux-2.6.x/drivers/usb/host/Kconfig
```kconfig
#
# USB Host Controller Drivers
#
comment "USB Host Controller Drivers"
	depends on USB

config USB_EHCI_HCD
	tristate "EHCI HCD (USB 2.0) support"
	depends on USB && PCI
	---help---
	  The Enhanced Host Controller Interface (EHCI) is standard for USB 2.0
	  "high speed" (480 Mbit/sec, 60 Mbyte/sec) host controller hardware.
	  If your USB host controller supports USB 2.0, you will likely want to
	  configure this Host Controller Driver.  At this writing, the primary
	  implementation of EHCI is a chip from NEC, widely available in add-on
	  PCI cards, but implementations are in the works from other vendors
	  including Intel and Philips.  Motherboard support is appearing.

	  EHCI controllers are packaged with "companion" host controllers (OHCI
	  or UHCI) to handle USB 1.1 devices connected to root hub ports.  Ports
	  will connect to EHCI if it the device is high speed, otherwise they
	  connect to a companion controller.  If you configure EHCI, you should
	  probably configure the OHCI (for NEC and some other vendors) USB Host
	  Controller Driver or UHCI (for Via motherboards) Host Controller
	  Driver too.

	  You may want to read <file:Documentation/usb/ehci.txt>.

	  To compile this driver as a module, choose M here: the
	  module will be called ehci-hcd.

config USB_EHCI_SPLIT_ISO
	bool "Full speed ISO transactions (EXPERIMENTAL)"
	depends on USB_EHCI_HCD && EXPERIMENTAL
	default n
	---help---
	  This code is new and hasn't been used with many different
	  EHCI or USB 2.0 transaction translator implementations.
	  It should work for ISO-OUT transfers, like audio.

config USB_EHCI_ROOT_HUB_TT
	bool "Root Hub Transaction Translators (EXPERIMENTAL)"
	depends on USB_EHCI_HCD && EXPERIMENTAL
	---help---
	  Some EHCI chips have vendor-specific extensions to integrate
	  transaction translators, so that no OHCI or UHCI companion
	  controller is needed.  It's safe to say "y" even if your
	  controller doesn't support this feature.

	  This supports the EHCI implementation from TransDimension Inc.

config USB_ISP1362_HCD
	tristate "ISP1362 HCD support"
	depends on USB
	default N
	---help---
	  Supports the Philips ISP1362 chip as a host controller

	  This driver does not support isochronous transfers.

	  To compile this driver as a module, choose M here: the
	  module will be called isp1362-hcd.

choice 
	prompt "GPIO for Interrupt"
	depends on (BF533 && USB_ISP1362_HCD)
	default USB_ISP1362_BFIN_PF4
	help
	  Choose an GPIO as isp1362's interrupt. This must corresponds to the JP3 on usb 
	  daughter card.

config  USB_ISP1362_BFIN_PF4
	bool "PF4"
	depends on BF533

config  USB_ISP1362_BFIN_PF8
	bool "PF8"
	depends on BF533

config  USB_ISP1362_BFIN_PF9
	bool "PF9"
	depends on BF533

config  USB_ISP1362_BFIN_PF14
	bool "PF14"
	depends on BF533

config  USB_ISP1362_BFIN_PF15
	bool "PF15"
	depends on BF533

endchoice

config USB_ISP1362_BFIN_GPIO
	int
	depends on (BF533 && USB_ISP1362_HCD)
	default 4 if (USB_ISP1362_BFIN_PF4 = y)
	default 8 if (USB_ISP1362_BFIN_PF8 = y)
	default 9 if (USB_ISP1362_BFIN_PF9 = y)
	default 14 if (USB_ISP1362_BFIN_PF14 = y)
	default 15 if (USB_ISP1362_BFIN_PF15 = y)

config USB_ISP1362_BFIN_GPIO
	int "GPIO for Interrupt"
	depends on (BF537 && USB_ISP1362_HCD)
	range 3 7
	default 3
	help
	  Choose an GPIO as isp1362's interrupt. This must corresponds to the JP3 on usb 
	  daughter card. The available value is from 3 to 7.

config USB_OHCI_HCD
	tristate "OHCI HCD support"
	depends on USB && USB_ARCH_HAS_OHCI
	select ISP1301_OMAP if MACH_OMAP_H2 || MACH_OMAP_H3
	---help---
	  The Open Host Controller Interface (OHCI) is a standard for accessing
	  USB 1.1 host controller hardware.  It does more in hardware than Intel's
	  UHCI specification.  If your USB host controller follows the OHCI spec,
	  say Y.  On most non-x86 systems, and on x86 hardware that's not using a
	  USB controller from Intel or VIA, this is appropriate.  If your host
	  controller doesn't use PCI, this is probably appropriate.  For a PCI
	  based system where you're not sure, the "lspci -v" entry will list the
	  right "prog-if" for your USB controller(s):  EHCI, OHCI, or UHCI.

	  To compile this driver as a module, choose M here: the
	  module will be called ohci-hcd.

config USB_OHCI_HCD_PPC_SOC
	bool "OHCI support for on-chip PPC USB controller"
	depends on USB_OHCI_HCD && (STB03xxx || PPC_MPC52xx)
	default y
	select USB_OHCI_BIG_ENDIAN
	---help---
	  Enables support for the USB controller on the MPC52xx or
	  STB03xxx processor chip.  If unsure, say Y.

config USB_OHCI_HCD_PCI
	bool "OHCI support for PCI-bus USB controllers"
	depends on USB_OHCI_HCD && PCI && (STB03xxx || PPC_MPC52xx)
	default y
	select USB_OHCI_LITTLE_ENDIAN
	---help---
	  Enables support for PCI-bus plug-in USB controller cards.
	  If unsure, say Y.

config USB_OHCI_BIG_ENDIAN
	bool
	depends on USB_OHCI_HCD
	default n

config USB_OHCI_LITTLE_ENDIAN
	bool
	depends on USB_OHCI_HCD
	default n if STB03xxx || PPC_MPC52xx
	default y

config USB_UHCI_HCD
	tristate "UHCI HCD (most Intel and VIA) support"
	depends on USB && PCI
	---help---
	  The Universal Host Controller Interface is a standard by Intel for
	  accessing the USB hardware in the PC (which is also called the USB
	  host controller). If your USB host controller conforms to this
	  standard, you may want to say Y, but see below. All recent boards
	  with Intel PCI chipsets (like intel 430TX, 440FX, 440LX, 440BX,
	  i810, i820) conform to this standard. Also all VIA PCI chipsets
	  (like VIA VP2, VP3, MVP3, Apollo Pro, Apollo Pro II or Apollo Pro
	  133). If unsure, say Y.

	  To compile this driver as a module, choose M here: the
	  module will be called uhci-hcd.

config USB_SL811_HCD
	tristate "SL811HS HCD support"
	depends on USB
	default N
	help
	  The SL811HS is a single-port USB controller that supports either
	  host side or peripheral side roles.  Enable this option if your
	  board has this chip, and you want to use it as a host controller. 
	  If unsure, say N.

	  To compile this driver as a module, choose M here: the
	  module will be called sl811-hcd.

config USB_SL811_CS
	tristate "CF/PCMCIA support for SL811HS HCD"
	depends on USB_SL811_HCD && PCMCIA
	default N
	help
	  Wraps a PCMCIA driver around the SL811HS HCD, supporting the RATOC
	  REX-CFU1U CF card (often used with PDAs).  If unsure, say N.

	  To compile this driver as a module, choose M here: the
	  module will be called "sl811_cs".
```

## linux-2.6.x/drivers/zaptel/Kconfig
```kconfig
#
# PBX driver configuration
#
#
menu "PBX support"

config PBX
	tristate "PBX support"
	help
	  PBX is Private Branch eXchange. BF533 and BF537 STAMP board now
	  support PBX card which has 2 FXS ports, as well as 2 FXO ports.

config J11_JUMPER
	int "Select J11 jumper on PBX card"
	depends on PBX
	default 7
	help
	  Input from 1-7, no confliction with others. 

config J16_JUMPER
	int "Select J16 jumper on PBX card"
	depends on PBX
	default 4
	help
	  Input from 1-7, no confliction with others.

config J19_JUMPER
	int "Select J19 jumper on PBX card"
	depends on PBX
	default 6
	help
	  Input form 1-7, no confliction with others.

endmenu # "PBX support"
```

## linux-2.6.x/sound/blackfin/Kconfig
```kconfig
#
# $Id$
#
menu "ALSA Blackfin devices"
	depends on SND && BFIN

config SND_BLACKFIN_AD1836
	tristate "AD1836 Audio support for BF53x"
	depends on SND && BFIN
	select SND_PCM
	select SPI
	select SPI_BFIN
	help
	  Select this if you have an AD1836 daughter card connected to
	  Blackfin Stamp Board by the SPI and SPORTx ports.

	  To compile this driver as a module, choose M here: the
	  module will be called snd-ad1836.

	  If unsure, say N.

choice
	prompt "Interface between Blackfin and AD1836"
	depends on SND_BLACKFIN_AD1836
	default SND_BLACKFIN_AD1836_TDM
	help
	  There are two types of interface can be supportted on Blackfin
	  Stamp: TDM and I2S. TDM support 8 channels (DAC0,1,2 SPDIF)*(L+R)
	  output and 8 channels input (ADC0,1, SPDIF, unused)*(L+R). I2S
	  only support stereo output on DAC0 and stereo input on ADC0.

config SND_BLACKFIN_AD1836_TDM
	boolean "TDM interface"
	help
	  TDM support all 4 stereo outputs and 3 stereo inputs.

	  If unsure, say Y.

config SND_BLACKFIN_AD1836_I2S
	boolean "I2S interface"
	help
	  I2S support 1 stereo output and 1 stereo input.

	  If unsure, say N.

endchoice
choice
	prompt "5.1 Channels or 3 Separate Stereos"
	depends on SND_BLACKFIN_AD1836_TDM
	default SND_BLACKFIN_AD1836_MULSUB
	help
	  There are 6 output channels (expcept S/PDIF), they can work in
	  5.1 channels mode or 3 seperate stereos.

	  When in 3 seperate stereos mode, 3 substreams are supported.
	  The /dev/dsp device can be opened 3 times, every susbstream used
	  different channels pairs.

config SND_BLACKFIN_AD1836_MULSUB
	boolean "3 Stereos"
	help
	  Support 3 separate stereos

	  If unsure, say Y.

config SND_BLACKFIN_AD1836_5P1
	boolean "5.1 Channels"
	help
	  Support 5.1 Channels.

	  If unsure, say N.

endchoice

# NOTE: Only tested on BF535 and never forward ported/validated since, thus disabled.
#
#config SND_BLACKFIN_ADI1981B
#	bool "1981b Audio support for BF53x"
#	depends on BFIN
#	select SND_PCM
#	help
#	  Select this if you have an 1981b connected to the SPORTx port
#
#	  If unsure, say N.

config SND_BLACKFIN_SPORT
	int "Blackfin Audio SPORT port"
	depends on SND_BLACKFIN_AD1836
	default 0
	help
	  Enter the Blackfin SPORT port to which your sound chip is connected
	  acceptable values are 0 or 1

config SND_BLACKFIN_SPI_PFBIT
	int "Blackfin Audio SPI channel selection bit"
	depends on SND_BLACKFIN_AD1836
	default 4
	help
	  Enter the Blackfin SPI channel to which your sound chip is connected
	  acceptable values are 0 to 7

config SND_BFIN_AD73311
	tristate "AD73311L Audio support for BF53x"
	depends on SND && BFIN
	select SND_PCM
	help
	  Select this if you have an AD73311 or AD73311L connected to SPORT0 ports

	  To compile this driver as a module, choose M here: the
	  module will be called snd-ad73311.

	  If unsure, say N.

config SND_BFIN_SPORT
	int "Blackfin Audio SPORT port"
	depends on SND_BFIN_AD73311
	default 0
	help
	  Enter the Blackfin SPORT port to which your sound chip is connected
	  acceptable values are 0 or 1

config SND_BFIN_AD73311_SE
	int "PF pin for AD73311L Chip Select"
	depends on SND_BFIN_AD73311
	default 4
	help
	  Enter the GPIO used to control AD73311's SE pin. Acceptable
	  values are 0 to 7

endmenu
```
